.equ __crc__burn_page_00, 0xc9394379
.equ __crc__burn_page_04, 0xa5bfe411
.equ __crc__burn_page_08, 0xc909d345
.equ __crc__burn_page_0c, 0x88e067b0
.equ __crc__burn_page_10, 0x4e8a63b8
.equ __crc__burn_page_14, 0x9d54a7f2
.equ __crc__burn_page_18, 0x9138785e
.equ __crc__burn_page_1c, 0x3434e64a
.equ __crc__burn_page_20, 0xb69cead8
.equ __crc__burn_page_24, 0x94c8299d
.equ __crc__burn_page_40, 0xdce3a612
.equ __crc__burn_page_a4, 0xf9f00c4c
.equ __crc__overall_hi, 0x58355e91
.equ __crc__overall_lo, 0x313afe5f
.equ __crc_addra__burn_page_00, 0x0043aa
.equ __crc_addra__burn_page_04, 0x003da0
.equ __crc_addra__burn_page_08, 0x003796
.equ __crc_addra__burn_page_0c, 0x00318c
.equ __crc_addra__burn_page_10, 0x002b82
.equ __crc_addra__burn_page_14, 0x002578
.equ __crc_addra__burn_page_18, 0x001f6e
.equ __crc_addra__burn_page_1c, 0x001964
.equ __crc_addra__burn_page_20, 0x00135a
.equ __crc_addra__burn_page_24, 0x000d50
.equ __crc_addra__burn_page_40, 0x000746
.equ __crc_addra__burn_page_a4, 0x000136
.equ __crc_addra__overall_hi, 0x00012c
.equ __crc_addra__overall_lo, 0x000000
.equ __crc_addrz__burn_page_00, 0x0049aa
.equ __crc_addrz__burn_page_04, 0x0043a0
.equ __crc_addrz__burn_page_08, 0x003d96
.equ __crc_addrz__burn_page_0c, 0x00378c
.equ __crc_addrz__burn_page_10, 0x003182
.equ __crc_addrz__burn_page_14, 0x002b78
.equ __crc_addrz__burn_page_18, 0x00256e
.equ __crc_addrz__burn_page_1c, 0x001f64
.equ __crc_addrz__burn_page_20, 0x00195a
.equ __crc_addrz__burn_page_24, 0x001350
.equ __crc_addrz__burn_page_40, 0x000d46
.equ __crc_addrz__burn_page_a4, 0x000736
.equ __crc_addrz__overall_hi, 0x0049b4
.equ __crc_addrz__overall_lo, 0x000128
.equ __psym__CALIBRATION_PROCEDURE, 0x087a
.equ __psym__LOADER_HI_ENTRY, 0xa5f2

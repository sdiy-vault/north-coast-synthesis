.word 0x0000	;   0 CX          8.176 Hz XXX
.word 0x0000	;   1 C#X/DbX     8.662 Hz XXX
.word 0x0000	;   2 DX          9.177 Hz XXX
.word 0x0000	;   3 D#X/EbX     9.723 Hz XXX
.word 0x0000	;   4 EX         10.301 Hz XXX
.word 0x0000	;   5 FX         10.913 Hz XXX
.word 0x0000	;   6 F#X/GbX    11.562 Hz XXX
.word 0x0000	;   7 GX         12.250 Hz XXX
.word 0x0000	;   8 G#X/AbX    12.978 Hz XXX
.word 0x0000	;   9 AX         13.750 Hz XXX
.word 0x0000	;  10 A#X/BbX    14.568 Hz XXX
.word 0x0000	;  11 BX         15.434 Hz XXX
.word 0x0000	;  12 C0         16.352 Hz XXX
.word 0x0000	;  13 C#0/Db0    17.324 Hz XXX
.word 0x0000	;  14 D0         18.354 Hz XXX
.word 0x0000	;  15 D#0/Eb0    19.445 Hz XXX
.word 0x0000	;  16 E0         20.602 Hz XXX
.word 0x0000	;  17 F0         21.827 Hz XXX
.word 0x0000	;  18 F#0/Gb0    23.125 Hz XXX
.word 0x0000	;  19 G0         24.500 Hz XXX
.word 0x0000	;  20 G#0/Ab0    25.957 Hz XXX
.word 0x0000	;  21 A0         27.500 Hz XXX
.word 0x0000	;  22 A#0/Bb0    29.135 Hz XXX
.word 0xFD18	;  23 B0         30.868 Hz
.word 0xEEE3	;  24 C1         32.703 Hz
.word 0xE17B	;  25 C#1/Db1    34.648 Hz
.word 0xD4D3	;  26 D1         36.708 Hz
.word 0xC8E1	;  27 D#1/Eb1    38.891 Hz
.word 0xBD9B	;  28 E1         41.203 Hz
.word 0xB2F6	;  29 F1         43.654 Hz
.word 0xA8EB	;  30 F#1/Gb1    46.249 Hz
.word 0x9F70	;  31 G1         48.999 Hz
.word 0x967D	;  32 G#1/Ab1    51.913 Hz
.word 0x8E0B	;  33 A1         55.000 Hz
.word 0x8612	;  34 A#1/Bb1    58.270 Hz
.word 0x7E8B	;  35 B1         61.735 Hz
.word 0x7771	;  36 C2         65.406 Hz
.word 0x70BD	;  37 C#2/Db2    69.296 Hz
.word 0x6A69	;  38 D2         73.416 Hz
.word 0x6470	;  39 D#2/Eb2    77.782 Hz
.word 0x5ECD	;  40 E2         82.407 Hz
.word 0x597B	;  41 F2         87.307 Hz
.word 0x5475	;  42 F#2/Gb2    92.499 Hz
.word 0x4FB7	;  43 G2         97.999 Hz
.word 0x4B3E	;  44 G#2/Ab2   103.826 Hz
.word 0x4705	;  45 A2        110.000 Hz
.word 0x4308	;  46 A#2/Bb2   116.541 Hz
.word 0x3F45	;  47 B2        123.471 Hz
.word 0x3BB8	;  48 C3        130.813 Hz
.word 0x385E	;  49 C#3/Db3   138.591 Hz
.word 0x3534	;  50 D3        146.832 Hz
.word 0x3237	;  51 D#3/Eb3   155.563 Hz
.word 0x2F66	;  52 E3        164.814 Hz
.word 0x2CBD	;  53 F3        174.614 Hz
.word 0x2A3A	;  54 F#3/Gb3   184.997 Hz
.word 0x27DB	;  55 G3        195.998 Hz
.word 0x259E	;  56 G#3/Ab3   207.652 Hz
.word 0x2382	;  57 A3        220.000 Hz
.word 0x2184	;  58 A#3/Bb3   233.082 Hz
.word 0x1FA2	;  59 B3        246.942 Hz
.word 0x1DDC	;  60 C4        261.626 Hz
.word 0x1C2E	;  61 C#4/Db4   277.183 Hz
.word 0x1A99	;  62 D4        293.665 Hz
.word 0x191B	;  63 D#4/Eb4   311.127 Hz
.word 0x17B2	;  64 E4        329.628 Hz
.word 0x165E	;  65 F4        349.228 Hz
.word 0x151C	;  66 F#4/Gb4   369.994 Hz
.word 0x13ED	;  67 G4        391.995 Hz
.word 0x12CF	;  68 G#4/Ab4   415.305 Hz
.word 0x11C0	;  69 A4        440.000 Hz
.word 0x10C1	;  70 A#4/Bb4   466.164 Hz
.word 0x0FD1	;  71 B4        493.883 Hz
.word 0x0EED	;  72 C5        523.251 Hz
.word 0x0E17	;  73 C#5/Db5   554.365 Hz
.word 0x0D4C	;  74 D5        587.330 Hz
.word 0x0C8D	;  75 D#5/Eb5   622.254 Hz
.word 0x0BD9	;  76 E5        659.255 Hz
.word 0x0B2E	;  77 F5        698.456 Hz
.word 0x0A8E	;  78 F#5/Gb5   739.989 Hz
.word 0x09F6	;  79 G5        783.991 Hz
.word 0x0967	;  80 G#5/Ab5   830.609 Hz
.word 0x08E0	;  81 A5        880.000 Hz
.word 0x0860	;  82 A#5/Bb5   932.328 Hz
.word 0x07E8	;  83 B5        987.767 Hz
.word 0x0776	;  84 C6       1046.502 Hz
.word 0x070B	;  85 C#6/Db6  1108.731 Hz
.word 0x06A6	;  86 D6       1174.659 Hz
.word 0x0646	;  87 D#6/Eb6  1244.508 Hz
.word 0x05EC	;  88 E6       1318.510 Hz
.word 0x0597	;  89 F6       1396.913 Hz
.word 0x0546	;  90 F#6/Gb6  1479.978 Hz
.word 0x04FB	;  91 G6       1567.982 Hz
.word 0x04B3	;  92 G#6/Ab6  1661.219 Hz
.word 0x046F	;  93 A6       1760.000 Hz
.word 0x0430	;  94 A#6/Bb6  1864.655 Hz
.word 0x03F3	;  95 B6       1975.533 Hz
.word 0x03BB	;  96 C7       2093.005 Hz
.word 0x0385	;  97 C#7/Db7  2217.461 Hz
.word 0x0352	;  98 D7       2349.318 Hz
.word 0x0323	;  99 D#7/Eb7  2489.016 Hz
.word 0x02F5	; 100 E7       2637.020 Hz
.word 0x02CB	; 101 F7       2793.826 Hz
.word 0x02A3	; 102 F#7/Gb7  2959.955 Hz
.word 0x027D	; 103 G7       3135.963 Hz
.word 0x0259	; 104 G#7/Ab7  3322.438 Hz
.word 0x0237	; 105 A7       3520.000 Hz
.word 0x0217	; 106 A#7/Bb7  3729.310 Hz
.word 0x01F9	; 107 B7       3951.066 Hz
.word 0x01DD	; 108 C8       4186.009 Hz
.word 0x01C2	; 109 C#8/Db8  4434.922 Hz
.word 0x01A9	; 110 D8       4698.636 Hz
.word 0x0191	; 111 D#8/Eb8  4978.032 Hz
.word 0x017A	; 112 E8       5274.041 Hz
.word 0x0165	; 113 F8       5587.652 Hz
.word 0x0151	; 114 F#8/Gb8  5919.911 Hz
.word 0x013E	; 115 G8       6271.927 Hz
.word 0x012C	; 116 G#8/Ab8  6644.875 Hz
.word 0x011B	; 117 A8       7040.000 Hz
.word 0x010B	; 118 A#8/Bb8  7458.620 Hz
.word 0x00FC	; 119 B8       7902.133 Hz
.word 0x00EE	; 120 C9       8372.018 Hz
.word 0x00E0	; 121 C#9/Db9  8869.844 Hz
.word 0x00D4	; 122 D9       9397.273 Hz
.word 0x00C8	; 123 D#9/Eb9  9956.063 Hz
.word 0x00BD	; 124 E9      10548.082 Hz
.word 0x00B2	; 125 F9      11175.303 Hz
.word 0x00A8	; 126 F#9/Gb9 11839.822 Hz
.word 0x009E	; 127 G9      12543.854 Hz
.word 0x0095	; 128 G#9/Ab9 13289.750 Hz
